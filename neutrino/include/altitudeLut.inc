        #include    "settings.inc"              ;specifies sensor used

ALTLUT  ORG ALTLUT_ADDR

; TODO: to save space, remove impossible values, below x, and above y

 if PRESSURE_SENSOR == MP3H6115A
        Data    0x3C56
        Data    0x3C20
        Data    0x3BE8
        Data    0x3BB1
        Data    0x3B7A
        Data    0x3B46
        Data    0x3B10
        Data    0x3ADA
        Data    0x3AA5
        Data    0x3A72
        Data    0x3A3E
        Data    0x3A0A
        Data    0x39D7
        Data    0x39A3
        Data    0x3972
        Data    0x3940
        Data    0x390E
        Data    0x38DC
        Data    0x38AD
        Data    0x387C
        Data    0x384B
        Data    0x381B
        Data    0x37EB
        Data    0x37BD
        Data    0x378D
        Data    0x375E
        Data    0x372F
        Data    0x3703
        Data    0x36D4
        Data    0x36A6
        Data    0x3679
        Data    0x364C
        Data    0x3620
        Data    0x35F3
        Data    0x35C7
        Data    0x359B
        Data    0x3570
        Data    0x3545
        Data    0x3519
        Data    0x34EE
        Data    0x34C3
        Data    0x349A
        Data    0x3470
        Data    0x3446
        Data    0x341C
        Data    0x33F4
        Data    0x33CA
        Data    0x33A1
        Data    0x3378
        Data    0x334F
        Data    0x3328
        Data    0x3300
        Data    0x32D8
        Data    0x32B0
        Data    0x328A
        Data    0x3262
        Data    0x323B
        Data    0x3214
        Data    0x31ED
        Data    0x31C8
        Data    0x31A2
        Data    0x317B
        Data    0x3155
        Data    0x3131
        Data    0x310B
        Data    0x30E6
        Data    0x30C1
        Data    0x309B
        Data    0x3078
        Data    0x3053
        Data    0x302F
        Data    0x300A
        Data    0x2FE7
        Data    0x2FC3
        Data    0x2F9F
        Data    0x2F7C
        Data    0x2F58
        Data    0x2F36
        Data    0x2F13
        Data    0x2EF0
        Data    0x2ECD
        Data    0x2EAB
        Data    0x2E89
        Data    0x2E66
        Data    0x2E44
        Data    0x2E22
        Data    0x2E01
        Data    0x2DDF
        Data    0x2DBE
        Data    0x2D9C
        Data    0x2D7C
        Data    0x2D5B
        Data    0x2D3A
        Data    0x2D19
        Data    0x2CF8
        Data    0x2CD9
        Data    0x2CB8
        Data    0x2C98
        Data    0x2C77
        Data    0x2C58
        Data    0x2C38
        Data    0x2C19
        Data    0x2BF9
        Data    0x2BD9
        Data    0x2BBB
        Data    0x2B9B
        Data    0x2B7C
        Data    0x2B5D
        Data    0x2B3F
        Data    0x2B20
        Data    0x2B02
        Data    0x2AE3
        Data    0x2AC5
        Data    0x2AA7
        Data    0x2A89
        Data    0x2A6B
        Data    0x2A4D
        Data    0x2A30
        Data    0x2A12
        Data    0x29F4
        Data    0x29D7
        Data    0x29B9
        Data    0x299D
        Data    0x2980
        Data    0x2962
        Data    0x2945
        Data    0x292A
        Data    0x290D
        Data    0x28F0
        Data    0x28D3
        Data    0x28B7
        Data    0x289B
        Data    0x287F
        Data    0x2863
        Data    0x2847
        Data    0x282C
        Data    0x2810
        Data    0x27F4
        Data    0x27D8
        Data    0x27BC
        Data    0x27A2
        Data    0x2786
        Data    0x276B
        Data    0x2750
        Data    0x2735
        Data    0x271A
        Data    0x26FF
        Data    0x26E4
        Data    0x26CA
        Data    0x26B0
        Data    0x2695
        Data    0x267B
        Data    0x2660
        Data    0x2647
        Data    0x262C
        Data    0x2612
        Data    0x25F8
        Data    0x25DE
        Data    0x25C5
        Data    0x25AB
        Data    0x2591
        Data    0x2577
        Data    0x255F
        Data    0x2545
        Data    0x252B
        Data    0x2512
        Data    0x24F9
        Data    0x24E0
        Data    0x24C7
        Data    0x24AE
        Data    0x2495
        Data    0x247D
        Data    0x2464
        Data    0x244B
        Data    0x2433
        Data    0x241A
        Data    0x2402
        Data    0x23EA
        Data    0x23D1
        Data    0x23B9
        Data    0x23A1
        Data    0x2389
        Data    0x2371
        Data    0x2359
        Data    0x2341
        Data    0x232A
        Data    0x2312
        Data    0x22FA
        Data    0x22E2
        Data    0x22CB
        Data    0x22B4
        Data    0x229C
        Data    0x2285
        Data    0x226D
        Data    0x2257
        Data    0x2240
        Data    0x2228
        Data    0x2211
        Data    0x21FB
        Data    0x21E4
        Data    0x21CD
        Data    0x21B6
        Data    0x219F
        Data    0x2189
        Data    0x2172
        Data    0x215C
        Data    0x2145
        Data    0x212F
        Data    0x2119
        Data    0x2103
        Data    0x20EC
        Data    0x20D6
        Data    0x20C0
        Data    0x20AA
        Data    0x2094
        Data    0x207E
        Data    0x2069
        Data    0x2053
        Data    0x203D
        Data    0x2027
        Data    0x2011
        Data    0x1FFC
        Data    0x1FE7
        Data    0x1FD1
        Data    0x1FBB
        Data    0x1FA7
        Data    0x1F91
        Data    0x1F7C
        Data    0x1F66
        Data    0x1F51
        Data    0x1F3D
        Data    0x1F27
        Data    0x1F12
        Data    0x1EFD
        Data    0x1EE9
        Data    0x1ED4
        Data    0x1EBF
        Data    0x1EAA
        Data    0x1E95
        Data    0x1E81
        Data    0x1E6C
        Data    0x1E58
        Data    0x1E43
        Data    0x1E2F
        Data    0x1E1B
        Data    0x1E06
        Data    0x1DF2
        Data    0x1DDD
        Data    0x1DCA
        Data    0x1DB5
        Data    0x1DA1
        Data    0x1D8D
        Data    0x1D79
        Data    0x1D65
        Data    0x1D51
        Data    0x1D3D
        Data    0x1D29
        Data    0x1D16
        Data    0x1D02
        Data    0x1CEE
        Data    0x1CDB
        Data    0x1CC7
        Data    0x1CB4
        Data    0x1CA0
        Data    0x1C8C
        Data    0x1C7A
        Data    0x1C66
        Data    0x1C53
        Data    0x1C3F
        Data    0x1C2C
        Data    0x1C19
        Data    0x1C06
        Data    0x1BF2
        Data    0x1BDF
        Data    0x1BCD
        Data    0x1BBA
        Data    0x1BA6
        Data    0x1B93
        Data    0x1B80
        Data    0x1B6E
        Data    0x1B5B
        Data    0x1B48
        Data    0x1B35
        Data    0x1B23
        Data    0x1B10
        Data    0x1AFE
        Data    0x1AEB
        Data    0x1AD8
        Data    0x1AC6
        Data    0x1AB4
        Data    0x1AA1
        Data    0x1A8F
        Data    0x1A7D
        Data    0x1A6A
        Data    0x1A58
        Data    0x1A46
        Data    0x1A33
        Data    0x1A22
        Data    0x1A0F
        Data    0x19FD
        Data    0x19EB
        Data    0x19DA
        Data    0x19C7
        Data    0x19B5
        Data    0x19A3
        Data    0x1991
        Data    0x1980
        Data    0x196E
        Data    0x195C
        Data    0x194A
        Data    0x1939
        Data    0x1927
        Data    0x1916
        Data    0x1904
        Data    0x18F2
        Data    0x18E1
        Data    0x18D0
        Data    0x18BE
        Data    0x18AD
        Data    0x189C
        Data    0x188A
        Data    0x1879
        Data    0x1868
        Data    0x1856
        Data    0x1845
        Data    0x1834
        Data    0x1823
        Data    0x1812
        Data    0x1801
        Data    0x17F0
        Data    0x17DF
        Data    0x17CE
        Data    0x17BD
        Data    0x17AC
        Data    0x179B
        Data    0x178A
        Data    0x1779
        Data    0x1769
        Data    0x1758
        Data    0x1747
        Data    0x1736
        Data    0x1726
        Data    0x1715
        Data    0x1705
        Data    0x16F4
        Data    0x16E3
        Data    0x16D3
        Data    0x16C3
        Data    0x16B2
        Data    0x16A2
        Data    0x1691
        Data    0x1681
        Data    0x1671
        Data    0x1660
        Data    0x1650
        Data    0x1640
        Data    0x1630
        Data    0x1620
        Data    0x160F
        Data    0x15FF
        Data    0x15EF
        Data    0x15DF
        Data    0x15CF
        Data    0x15BF
        Data    0x15AF
        Data    0x159F
        Data    0x158F
        Data    0x157F
        Data    0x156F
        Data    0x1560
        Data    0x1550
        Data    0x1540
        Data    0x1530
        Data    0x1521
        Data    0x1511
        Data    0x1501
        Data    0x14F1
        Data    0x14E2
        Data    0x14D3
        Data    0x14C3
        Data    0x14B3
        Data    0x14A4
        Data    0x1495
        Data    0x1485
        Data    0x1475
        Data    0x1466
        Data    0x1456
        Data    0x1447
        Data    0x1438
        Data    0x1429
        Data    0x1419
        Data    0x140A
        Data    0x13FB
        Data    0x13EC
        Data    0x13DC
        Data    0x13CD
        Data    0x13BE
        Data    0x13AF
        Data    0x13A0
        Data    0x1391
        Data    0x1382
        Data    0x1373
        Data    0x1364
        Data    0x1355
        Data    0x1346
        Data    0x1337
        Data    0x1328
        Data    0x1319
        Data    0x130A
        Data    0x12FC
        Data    0x12ED
        Data    0x12DE
        Data    0x12CF
        Data    0x12C0
        Data    0x12B2
        Data    0x12A3
        Data    0x1295
        Data    0x1286
        Data    0x1278
        Data    0x1269
        Data    0x125A
        Data    0x124C
        Data    0x123D
        Data    0x122F
        Data    0x1220
        Data    0x1212
        Data    0x1203
        Data    0x11F5
        Data    0x11E7
        Data    0x11D8
        Data    0x11CA
        Data    0x11BB
        Data    0x11AD
        Data    0x119F
        Data    0x1191
        Data    0x1182
        Data    0x1174
        Data    0x1166
        Data    0x1158
        Data    0x114A
        Data    0x113B
        Data    0x112E
        Data    0x1120
        Data    0x1111
        Data    0x1103
        Data    0x10F6
        Data    0x10E7
        Data    0x10D9
        Data    0x10CB
        Data    0x10BD
        Data    0x10B0
        Data    0x10A2
        Data    0x1094
        Data    0x1086
        Data    0x1078
        Data    0x106A
        Data    0x105D
        Data    0x104F
        Data    0x1041
        Data    0x1033
        Data    0x1026
        Data    0x1018
        Data    0x100A
        Data    0x0FFD
        Data    0x0FEF
        Data    0x0FE1
        Data    0x0FD4
        Data    0x0FC6
        Data    0x0FB9
        Data    0x0FAB
        Data    0x0F9E
        Data    0x0F90
        Data    0x0F83
        Data    0x0F75
        Data    0x0F68
        Data    0x0F5A
        Data    0x0F4D
        Data    0x0F40
        Data    0x0F32
        Data    0x0F25
        Data    0x0F17
        Data    0x0F0A
        Data    0x0EFD
        Data    0x0EF0
        Data    0x0EE2
        Data    0x0ED5
        Data    0x0EC8
        Data    0x0EBB
        Data    0x0EAD
        Data    0x0EA0
        Data    0x0E93
        Data    0x0E86
        Data    0x0E79
        Data    0x0E6C
        Data    0x0E5F
        Data    0x0E52
        Data    0x0E45
        Data    0x0E38
        Data    0x0E2B
        Data    0x0E1E
        Data    0x0E11
        Data    0x0E04
        Data    0x0DF7
        Data    0x0DEA
        Data    0x0DDD
        Data    0x0DD0
        Data    0x0DC3
        Data    0x0DB6
        Data    0x0DAA
        Data    0x0D9D
        Data    0x0D90
        Data    0x0D83
        Data    0x0D76
        Data    0x0D6A
        Data    0x0D5D
        Data    0x0D50
        Data    0x0D44
        Data    0x0D37
        Data    0x0D2B
        Data    0x0D1E
        Data    0x0D11
        Data    0x0D05
        Data    0x0CF8
        Data    0x0CEB
        Data    0x0CDF
        Data    0x0CD2
        Data    0x0CC6
        Data    0x0CB9
        Data    0x0CAD
        Data    0x0CA0
        Data    0x0C94
        Data    0x0C88
        Data    0x0C7B
        Data    0x0C6F
        Data    0x0C62
        Data    0x0C56
        Data    0x0C4A
        Data    0x0C3D
        Data    0x0C31
        Data    0x0C25
        Data    0x0C18
        Data    0x0C0C
        Data    0x0C00
        Data    0x0BF3
        Data    0x0BE7
        Data    0x0BDB
        Data    0x0BCF
        Data    0x0BC2
        Data    0x0BB7
        Data    0x0BAA
        Data    0x0B9E
        Data    0x0B92
        Data    0x0B86
        Data    0x0B7A
        Data    0x0B6E
        Data    0x0B62
        Data    0x0B55
        Data    0x0B4A
        Data    0x0B3E
        Data    0x0B31
        Data    0x0B25
        Data    0x0B19
        Data    0x0B0E
        Data    0x0B02
        Data    0x0AF6
        Data    0x0AEA
        Data    0x0ADE
        Data    0x0AD2
        Data    0x0AC6
        Data    0x0ABA
        Data    0x0AAE
        Data    0x0AA3
        Data    0x0A97
        Data    0x0A8B
        Data    0x0A7F
        Data    0x0A73
        Data    0x0A68
        Data    0x0A5C
        Data    0x0A50
        Data    0x0A44
        Data    0x0A39
        Data    0x0A2D
        Data    0x0A21
        Data    0x0A15
        Data    0x0A0A
        Data    0x09FE
        Data    0x09F3
        Data    0x09E7
        Data    0x09DB
        Data    0x09D0
        Data    0x09C4
        Data    0x09B9
        Data    0x09AD
        Data    0x09A2
        Data    0x0996
        Data    0x098B
        Data    0x097F
        Data    0x0973
        Data    0x0968
        Data    0x095D
        Data    0x0951
        Data    0x0946
        Data    0x093B
        Data    0x092F
        Data    0x0924
        Data    0x0918
        Data    0x090D
        Data    0x0902
        Data    0x08F6
        Data    0x08EB
        Data    0x08E0
        Data    0x08D5
        Data    0x08C9
        Data    0x08BE
        Data    0x08B2
        Data    0x08A7
        Data    0x089C
        Data    0x0891
        Data    0x0886
        Data    0x087A
        Data    0x086F
        Data    0x0864
        Data    0x0859
        Data    0x084E
        Data    0x0843
        Data    0x0838
        Data    0x082D
        Data    0x0821
        Data    0x0816
        Data    0x080B
        Data    0x0800
        Data    0x07F5
        Data    0x07EA
        Data    0x07DF
        Data    0x07D4
        Data    0x07C9
        Data    0x07BE
        Data    0x07B3
        Data    0x07A8
        Data    0x079D
        Data    0x0792
        Data    0x0787
        Data    0x077C
        Data    0x0772
        Data    0x0767
        Data    0x075C
        Data    0x0751
        Data    0x0746
        Data    0x073B
        Data    0x0731
        Data    0x0726
        Data    0x071B
        Data    0x0710
        Data    0x0705
        Data    0x06FB
        Data    0x06F0
        Data    0x06E5
        Data    0x06DA
        Data    0x06D0
        Data    0x06C5
        Data    0x06BA
        Data    0x06B0
        Data    0x06A5
        Data    0x069A
        Data    0x068F
        Data    0x0685
        Data    0x067A
        Data    0x0670
        Data    0x0665
        Data    0x065A
        Data    0x0650
        Data    0x0645
        Data    0x063B
        Data    0x0630
        Data    0x0626
        Data    0x061B
        Data    0x0611
        Data    0x0606
        Data    0x05FB
        Data    0x05F1
        Data    0x05E7
        Data    0x05DC
        Data    0x05D2
        Data    0x05C7
        Data    0x05BD
        Data    0x05B2
        Data    0x05A8
        Data    0x059D
        Data    0x0593
        Data    0x0589
        Data    0x057E
        Data    0x0574
        Data    0x056A
        Data    0x0560
        Data    0x0555
        Data    0x054B
        Data    0x0540
        Data    0x0536
        Data    0x052C
        Data    0x0522
        Data    0x0517
        Data    0x050D
        Data    0x0503
        Data    0x04F9
        Data    0x04EE
        Data    0x04E4
        Data    0x04DA
        Data    0x04D0
        Data    0x04C6
        Data    0x04BB
        Data    0x04B2
        Data    0x04A7
        Data    0x049D
        Data    0x0493
        Data    0x0489
        Data    0x047F
        Data    0x0475
        Data    0x046B
        Data    0x0460
        Data    0x0457
        Data    0x044C
        Data    0x0442
        Data    0x0438
        Data    0x042E
        Data    0x0424
        Data    0x041A
        Data    0x0410
        Data    0x0406
        Data    0x03FC
        Data    0x03F2
        Data    0x03E8
        Data    0x03DE
        Data    0x03D4
        Data    0x03CB
        Data    0x03C1
        Data    0x03B7
        Data    0x03AD
        Data    0x03A3
        Data    0x0399
        Data    0x038F
        Data    0x0385
        Data    0x037B
        Data    0x0372
        Data    0x0368
        Data    0x035E
        Data    0x0354
        Data    0x034A
        Data    0x0341
        Data    0x0337
        Data    0x032D
        Data    0x0323
        Data    0x031A
        Data    0x0310
        Data    0x0306
        Data    0x02FC
        Data    0x02F3
        Data    0x02E9
        Data    0x02DF
        Data    0x02D5
        Data    0x02CC
        Data    0x02C2
        Data    0x02B8
        Data    0x02AF
        Data    0x02A5
        Data    0x029C
        Data    0x0292
        Data    0x0288
        Data    0x027E
        Data    0x0275
        Data    0x026B
        Data    0x0262
        Data    0x0258
        Data    0x024E
        Data    0x0245
        Data    0x023C
        Data    0x0232
        Data    0x0228
        Data    0x021F
        Data    0x0215
        Data    0x020C
        Data    0x0202
        Data    0x01F9
        Data    0x01F0
        Data    0x01E6
        Data    0x01DC
        Data    0x01D3
        Data    0x01CA
        Data    0x01C0
        Data    0x01B7
        Data    0x01AD
        Data    0x01A4
        Data    0x019B
        Data    0x0191
        Data    0x0188
        Data    0x017E
        Data    0x0175
        Data    0x016C
        Data    0x0162
        Data    0x0159
        Data    0x014F
        Data    0x0146
        Data    0x013D
        Data    0x0134
        Data    0x012A
        Data    0x0121
        Data    0x0118
        Data    0x010F
        Data    0x0105
        Data    0x00FC
        Data    0x00F3
        Data    0x00EA
        Data    0x00E0
        Data    0x00D7
        Data    0x00CE
        Data    0x00C5
        Data    0x00BB
        Data    0x00B2
        Data    0x00A9
        Data    0x00A0
        Data    0x0097
        Data    0x008D
        Data    0x0084
        Data    0x007B
        Data    0x0072
        Data    0x0069
        Data    0x0060
        Data    0x0057
        Data    0x004E
        Data    0x0045
        Data    0x003B
        Data    0x0032
        Data    0x0029
        Data    0x0020
        Data    0x0017
        Data    0x000E
        Data    0x0005

        ; Negative
        Data    0xFFFC
        Data    0xFFF3
        Data    0xFFEA
        Data    0xFFE1
        Data    0xFFD8
        Data    0xFFCF
        Data    0xFFC6
        Data    0xFFBD
        Data    0xFFB4
        Data    0xFFAB
        Data    0xFFA2
        Data    0xFF99
        Data    0xFF90
        Data    0xFF87
        Data    0xFF7E
        Data    0xFF75
        Data    0xFF6D
        Data    0xFF64
        Data    0xFF5B
        Data    0xFF52
        Data    0xFF49
        Data    0xFF40
        Data    0xFF37
        Data    0xFF2F
        Data    0xFF26
        Data    0xFF1D
        Data    0xFF14
        Data    0xFF0B
        Data    0xFF02
        Data    0xFEF9
        Data    0xFEF1
        Data    0xFEE8
        Data    0xFEDF
        Data    0xFED6
        Data    0xFECD
        Data    0xFEC5
        Data    0xFEBC
        Data    0xFEB3
        Data    0xFEAA
        Data    0xFEA2
        Data    0xFE99
        Data    0xFE90
        Data    0xFE88
        Data    0xFE7F
        Data    0xFE76
        Data    0xFE6E
        Data    0xFE65
        Data    0xFE5C
        Data    0xFE53
        Data    0xFE4B
        Data    0xFE42
        Data    0xFE39
        Data    0xFE31
        Data    0xFE28
        Data    0xFE20
        Data    0xFE17
        Data    0xFE0E
        Data    0xFE06
        Data    0xFDFD
        Data    0xFDF5
        Data    0xFDEC
        Data    0xFDE3
        Data    0xFDDB
        Data    0xFDD2
        Data    0xFDCA
        Data    0xFDC1
        Data    0xFDB8
        Data    0xFDB0
        Data    0xFDA7
        Data    0xFD9F
        Data    0xFD96
        Data    0xFD8E
        Data    0xFD85
        Data    0xFD7D
        Data    0xFD74
        Data    0xFD6C
        Data    0xFD64
        Data    0xFD5B
        Data    0xFD52
        Data    0xFD4A
        Data    0xFD41
        Data    0xFD39
        Data    0xFD31
        Data    0xFD28
        Data    0xFD20
        Data    0xFD18
        Data    0xFD0F
        Data    0xFD07
        Data    0xFCFE
        Data    0xFCF6
        Data    0xFCEE
        Data    0xFCE5
        Data    0xFCDD
        Data    0xFCD4
        Data    0xFCCC
        Data    0xFCC4
        Data    0xFCBB
        Data    0xFCB3
        Data    0xFCAA
        Data    0xFCA2
        Data    0xFC9A
        Data    0xFC92
        Data    0xFC89
        Data    0xFC81
        Data    0xFC79
        Data    0xFC70
        Data    0xFC68
        Data    0xFC60
        Data    0xFC58
        Data    0xFC4F
        Data    0xFC47
        Data    0xFC3F
        Data    0xFC37
        Data    0xFC2E
        Data    0xFC26
        Data    0xFC1E
        Data    0xFC16
        Data    0xFC0E
        Data    0xFC05
        Data    0xFBFD
        Data    0xFBF5
        Data    0xFBED
        Data    0xFBE5
        Data    0xFBDC
        Data    0xFBD4
        Data    0xFBCC
        Data    0xFBC4
        Data    0xFBBC
        Data    0xFBB4
        Data    0xFBAB
        Data    0xFBA3
        Data    0xFB9B
        Data    0xFB93
        Data    0xFB8B
        Data    0xFB83
        Data    0xFB7B
        Data    0xFB73
        Data    0xFB6B
        Data    0xFB62
        Data    0xFB5B
        Data    0xFB52
        Data    0xFB4A
        Data    0xFB42
        Data    0xFB3A
        Data    0xFB32
        Data    0xFB2A
        Data    0xFB22
        Data    0xFB1A
        Data    0xFB12
        Data    0xFB0A
        Data    0xFB02
        Data    0xFAFA
        Data    0xFAF2
        Data    0xFAEA
        Data    0xFAE2
        Data    0xFADA
        Data    0xFAD2
        Data    0xFACA
        Data    0xFAC2
        Data    0xFABA
        Data    0xFAB2
        Data    0xFAAA
        Data    0xFAA3
        Data    0xFA9B
        Data    0xFA93
        Data    0xFA8B
        Data    0xFA83
        Data    0xFA7B
        Data    0xFA73
        Data    0xFA6B
        Data    0xFA63
        Data    0xFA5B
        Data    0xFA53
        Data    0xFA4C
        Data    0xFA44
        Data    0xFA3C
        Data    0xFA34
        Data    0xFA2C
        Data    0xFA24
        Data    0xFA1C
        Data    0xFA15
        Data    0xFA0D
        Data    0xFA05
        Data    0xF9FD
        Data    0xF9F5
        Data    0xF9EE
        Data    0xF9E6
        Data    0xF9DE
    endif

    if PRESSURE_SENSOR == MPL115A2
        Data    0x571A
        Data    0x56F4
        Data    0x56CF
        Data    0x56A9
        Data    0x5684
        Data    0x565F
        Data    0x563A
        Data    0x5614
        Data    0x55EF
        Data    0x55CA
        Data    0x55A5
        Data    0x5580
        Data    0x555B
        Data    0x5536
        Data    0x5511
        Data    0x54EC
        Data    0x54C7
        Data    0x54A2
        Data    0x547D
        Data    0x5458
        Data    0x5434
        Data    0x540F
        Data    0x53EA
        Data    0x53C6
        Data    0x53A1
        Data    0x537D
        Data    0x5358
        Data    0x5333
        Data    0x530F
        Data    0x52EB
        Data    0x52C6
        Data    0x52A2
        Data    0x527E
        Data    0x5259
        Data    0x5235
        Data    0x5211
        Data    0x51ED
        Data    0x51C9
        Data    0x51A4
        Data    0x5180
        Data    0x515C
        Data    0x5138
        Data    0x5114
        Data    0x50F1
        Data    0x50CD
        Data    0x50A9
        Data    0x5085
        Data    0x5061
        Data    0x503D
        Data    0x501A
        Data    0x4FF6
        Data    0x4FD2
        Data    0x4FAF
        Data    0x4F8B
        Data    0x4F68
        Data    0x4F44
        Data    0x4F21
        Data    0x4EFD
        Data    0x4EDA
        Data    0x4EB7
        Data    0x4E93
        Data    0x4E70
        Data    0x4E4D
        Data    0x4E29
        Data    0x4E06
        Data    0x4DE3
        Data    0x4DC0
        Data    0x4D9D
        Data    0x4D7A
        Data    0x4D57
        Data    0x4D34
        Data    0x4D11
        Data    0x4CEE
        Data    0x4CCB
        Data    0x4CA8
        Data    0x4C85
        Data    0x4C62
        Data    0x4C40
        Data    0x4C1D
        Data    0x4BFA
        Data    0x4BD8
        Data    0x4BB5
        Data    0x4B92
        Data    0x4B70
        Data    0x4B4D
        Data    0x4B2B
        Data    0x4B08
        Data    0x4AE6
        Data    0x4AC3
        Data    0x4AA1
        Data    0x4A7F
        Data    0x4A5C
        Data    0x4A3A
        Data    0x4A18
        Data    0x49F5
        Data    0x49D3
        Data    0x49B1
        Data    0x498F
        Data    0x496D
        Data    0x494B
        Data    0x4929
        Data    0x4907
        Data    0x48E5
        Data    0x48C3
        Data    0x48A1
        Data    0x487F
        Data    0x485D
        Data    0x483B
        Data    0x481A
        Data    0x47F8
        Data    0x47D6
        Data    0x47B4
        Data    0x4793
        Data    0x4771
        Data    0x474F
        Data    0x472E
        Data    0x470C
        Data    0x46EB
        Data    0x46C9
        Data    0x46A8
        Data    0x4686
        Data    0x4665
        Data    0x4644
        Data    0x4622
        Data    0x4601
        Data    0x45E0
        Data    0x45BF
        Data    0x459D
        Data    0x457C
        Data    0x455B
        Data    0x453A
        Data    0x4519
        Data    0x44F8
        Data    0x44D7
        Data    0x44B6
        Data    0x4495
        Data    0x4474
        Data    0x4453
        Data    0x4432
        Data    0x4411
        Data    0x43F0
        Data    0x43CF
        Data    0x43AF
        Data    0x438E
        Data    0x436D
        Data    0x434C
        Data    0x432C
        Data    0x430B
        Data    0x42EA
        Data    0x42CA
        Data    0x42A9
        Data    0x4289
        Data    0x4268
        Data    0x4248
        Data    0x4227
        Data    0x4207
        Data    0x41E6
        Data    0x41C6
        Data    0x41A6
        Data    0x4185
        Data    0x4165
        Data    0x4145
        Data    0x4125
        Data    0x4105
        Data    0x40E4
        Data    0x40C4
        Data    0x40A4
        Data    0x4084
        Data    0x4064
        Data    0x4044
        Data    0x4024
        Data    0x4004
        Data    0x3FE4
        Data    0x3FC4
        Data    0x3FA4
        Data    0x3F84
        Data    0x3F64
        Data    0x3F45
        Data    0x3F25
        Data    0x3F05
        Data    0x3EE5
        Data    0x3EC6
        Data    0x3EA6
        Data    0x3E86
        Data    0x3E67
        Data    0x3E47
        Data    0x3E27
        Data    0x3E08
        Data    0x3DE8
        Data    0x3DC9
        Data    0x3DA9
        Data    0x3D8A
        Data    0x3D6B
        Data    0x3D4B
        Data    0x3D2C
        Data    0x3D0C
        Data    0x3CED
        Data    0x3CCE
        Data    0x3CAF
        Data    0x3C8F
        Data    0x3C70
        Data    0x3C51
        Data    0x3C32
        Data    0x3C13
        Data    0x3BF4
        Data    0x3BD4
        Data    0x3BB5
        Data    0x3B96
        Data    0x3B77
        Data    0x3B58
        Data    0x3B39
        Data    0x3B1A
        Data    0x3AFC
        Data    0x3ADD
        Data    0x3ABE
        Data    0x3A9F
        Data    0x3A80
        Data    0x3A61
        Data    0x3A43
        Data    0x3A24
        Data    0x3A05
        Data    0x39E6
        Data    0x39C8
        Data    0x39A9
        Data    0x398B
        Data    0x396C
        Data    0x394D
        Data    0x392F
        Data    0x3910
        Data    0x38F2
        Data    0x38D3
        Data    0x38B5
        Data    0x3897
        Data    0x3878
        Data    0x385A
        Data    0x383B
        Data    0x381D
        Data    0x37FF
        Data    0x37E0
        Data    0x37C2
        Data    0x37A4
        Data    0x3786
        Data    0x3768
        Data    0x3749
        Data    0x372B
        Data    0x370D
        Data    0x36EF
        Data    0x36D1
        Data    0x36B3
        Data    0x3695
        Data    0x3677
        Data    0x3659
        Data    0x363B
        Data    0x361D
        Data    0x35FF
        Data    0x35E1
        Data    0x35C4
        Data    0x35A6
        Data    0x3588
        Data    0x356A
        Data    0x354C
        Data    0x352F
        Data    0x3511
        Data    0x34F3
        Data    0x34D6
        Data    0x34B8
        Data    0x349A
        Data    0x347D
        Data    0x345F
        Data    0x3442
        Data    0x3424
        Data    0x3407
        Data    0x33E9
        Data    0x33CC
        Data    0x33AE
        Data    0x3391
        Data    0x3373
        Data    0x3356
        Data    0x3339
        Data    0x331B
        Data    0x32FE
        Data    0x32E1
        Data    0x32C4
        Data    0x32A6
        Data    0x3289
        Data    0x326C
        Data    0x324F
        Data    0x3232
        Data    0x3214
        Data    0x31F7
        Data    0x31DA
        Data    0x31BD
        Data    0x31A0
        Data    0x3183
        Data    0x3166
        Data    0x3149
        Data    0x312C
        Data    0x310F
        Data    0x30F2
        Data    0x30D5
        Data    0x30B9
        Data    0x309C
        Data    0x307F
        Data    0x3062
        Data    0x3045
        Data    0x3029
        Data    0x300C
        Data    0x2FEF
        Data    0x2FD2
        Data    0x2FB6
        Data    0x2F99
        Data    0x2F7C
        Data    0x2F60
        Data    0x2F43
        Data    0x2F27
        Data    0x2F0A
        Data    0x2EEE
        Data    0x2ED1
        Data    0x2EB5
        Data    0x2E98
        Data    0x2E7C
        Data    0x2E5F
        Data    0x2E43
        Data    0x2E26
        Data    0x2E0A
        Data    0x2DEE
        Data    0x2DD1
        Data    0x2DB5
        Data    0x2D99
        Data    0x2D7D
        Data    0x2D60
        Data    0x2D44
        Data    0x2D28
        Data    0x2D0C
        Data    0x2CF0
        Data    0x2CD4
        Data    0x2CB7
        Data    0x2C9B
        Data    0x2C7F
        Data    0x2C63
        Data    0x2C47
        Data    0x2C2B
        Data    0x2C0F
        Data    0x2BF3
        Data    0x2BD7
        Data    0x2BBB
        Data    0x2B9F
        Data    0x2B83
        Data    0x2B68
        Data    0x2B4C
        Data    0x2B30
        Data    0x2B14
        Data    0x2AF8
        Data    0x2ADD
        Data    0x2AC1
        Data    0x2AA5
        Data    0x2A89
        Data    0x2A6E
        Data    0x2A52
        Data    0x2A36
        Data    0x2A1B
        Data    0x29FF
        Data    0x29E3
        Data    0x29C8
        Data    0x29AC
        Data    0x2991
        Data    0x2975
        Data    0x295A
        Data    0x293E
        Data    0x2923
        Data    0x2907
        Data    0x28EC
        Data    0x28D0
        Data    0x28B5
        Data    0x289A
        Data    0x287E
        Data    0x2863
        Data    0x2848
        Data    0x282C
        Data    0x2811
        Data    0x27F6
        Data    0x27DB
        Data    0x27BF
        Data    0x27A4
        Data    0x2789
        Data    0x276E
        Data    0x2753
        Data    0x2738
        Data    0x271D
        Data    0x2702
        Data    0x26E6
        Data    0x26CB
        Data    0x26B0
        Data    0x2695
        Data    0x267A
        Data    0x265F
        Data    0x2644
        Data    0x2629
        Data    0x260F
        Data    0x25F4
        Data    0x25D9
        Data    0x25BE
        Data    0x25A3
        Data    0x2588
        Data    0x256D
        Data    0x2553
        Data    0x2538
        Data    0x251D
        Data    0x2502
        Data    0x24E8
        Data    0x24CD
        Data    0x24B2
        Data    0x2498
        Data    0x247D
        Data    0x2462
        Data    0x2448
        Data    0x242D
        Data    0x2413
        Data    0x23F8
        Data    0x23DE
        Data    0x23C3
        Data    0x23A8
        Data    0x238E
        Data    0x2374
        Data    0x2359
        Data    0x233F
        Data    0x2324
        Data    0x230A
        Data    0x22EF
        Data    0x22D5
        Data    0x22BB
        Data    0x22A0
        Data    0x2286
        Data    0x226C
        Data    0x2252
        Data    0x2237
        Data    0x221D
        Data    0x2203
        Data    0x21E9
        Data    0x21CE
        Data    0x21B4
        Data    0x219A
        Data    0x2180
        Data    0x2166
        Data    0x214C
        Data    0x2132
        Data    0x2118
        Data    0x20FE
        Data    0x20E4
        Data    0x20CA
        Data    0x20B0
        Data    0x2096
        Data    0x207C
        Data    0x2062
        Data    0x2048
        Data    0x202E
        Data    0x2014
        Data    0x1FFA
        Data    0x1FE0
        Data    0x1FC6
        Data    0x1FAD
        Data    0x1F93
        Data    0x1F79
        Data    0x1F5F
        Data    0x1F45
        Data    0x1F2C
        Data    0x1F12
        Data    0x1EF8
        Data    0x1EDF
        Data    0x1EC5
        Data    0x1EAB
        Data    0x1E92
        Data    0x1E78
        Data    0x1E5E
        Data    0x1E45
        Data    0x1E2B
        Data    0x1E12
        Data    0x1DF8
        Data    0x1DDE
        Data    0x1DC5
        Data    0x1DAB
        Data    0x1D92
        Data    0x1D79
        Data    0x1D5F
        Data    0x1D46
        Data    0x1D2C
        Data    0x1D13
        Data    0x1CF9
        Data    0x1CE0
        Data    0x1CC7
        Data    0x1CAD
        Data    0x1C94
        Data    0x1C7B
        Data    0x1C61
        Data    0x1C48
        Data    0x1C2F
        Data    0x1C16
        Data    0x1BFC
        Data    0x1BE3
        Data    0x1BCA
        Data    0x1BB1
        Data    0x1B98
        Data    0x1B7F
        Data    0x1B65
        Data    0x1B4C
        Data    0x1B33
        Data    0x1B1A
        Data    0x1B01
        Data    0x1AE8
        Data    0x1ACF
        Data    0x1AB6
        Data    0x1A9D
        Data    0x1A84
        Data    0x1A6B
        Data    0x1A52
        Data    0x1A39
        Data    0x1A20
        Data    0x1A07
        Data    0x19EE
        Data    0x19D6
        Data    0x19BD
        Data    0x19A4
        Data    0x198B
        Data    0x1972
        Data    0x1959
        Data    0x1941
        Data    0x1928
        Data    0x190F
        Data    0x18F6
        Data    0x18DE
        Data    0x18C5
        Data    0x18AC
        Data    0x1894
        Data    0x187B
        Data    0x1862
        Data    0x184A
        Data    0x1831
        Data    0x1818
        Data    0x1800
        Data    0x17E7
        Data    0x17CF
        Data    0x17B6
        Data    0x179E
        Data    0x1785
        Data    0x176D
        Data    0x1754
        Data    0x173C
        Data    0x1723
        Data    0x170B
        Data    0x16F2
        Data    0x16DA
        Data    0x16C1
        Data    0x16A9
        Data    0x1691
        Data    0x1678
        Data    0x1660
        Data    0x1648
        Data    0x162F
        Data    0x1617
        Data    0x15FF
        Data    0x15E7
        Data    0x15CE
        Data    0x15B6
        Data    0x159E
        Data    0x1586
        Data    0x156D
        Data    0x1555
        Data    0x153D
        Data    0x1525
        Data    0x150D
        Data    0x14F5
        Data    0x14DD
        Data    0x14C5
        Data    0x14AC
        Data    0x1494
        Data    0x147C
        Data    0x1464
        Data    0x144C
        Data    0x1434
        Data    0x141C
        Data    0x1404
        Data    0x13EC
        Data    0x13D4
        Data    0x13BC
        Data    0x13A5
        Data    0x138D
        Data    0x1375
        Data    0x135D
        Data    0x1345
        Data    0x132D
        Data    0x1315
        Data    0x12FE
        Data    0x12E6
        Data    0x12CE
        Data    0x12B6
        Data    0x129E
        Data    0x1287
        Data    0x126F
        Data    0x1257
        Data    0x123F
        Data    0x1228
        Data    0x1210
        Data    0x11F8
        Data    0x11E1
        Data    0x11C9
        Data    0x11B1
        Data    0x119A
        Data    0x1182
        Data    0x116B
        Data    0x1153
        Data    0x113C
        Data    0x1124
        Data    0x110C
        Data    0x10F5
        Data    0x10DD
        Data    0x10C6
        Data    0x10AF
        Data    0x1097
        Data    0x1080
        Data    0x1068
        Data    0x1051
        Data    0x1039
        Data    0x1022
        Data    0x100B
        Data    0x0FF3
        Data    0x0FDC
        Data    0x0FC4
        Data    0x0FAD
        Data    0x0F96
        Data    0x0F7F
        Data    0x0F67
        Data    0x0F50
        Data    0x0F39
        Data    0x0F21
        Data    0x0F0A
        Data    0x0EF3
        Data    0x0EDC
        Data    0x0EC5
        Data    0x0EAD
        Data    0x0E96
        Data    0x0E7F
        Data    0x0E68
        Data    0x0E51
        Data    0x0E3A
        Data    0x0E23
        Data    0x0E0C
        Data    0x0DF4
        Data    0x0DDD
        Data    0x0DC6
        Data    0x0DAF
        Data    0x0D98
        Data    0x0D81
        Data    0x0D6A
        Data    0x0D53
        Data    0x0D3C
        Data    0x0D25
        Data    0x0D0E
        Data    0x0CF7
        Data    0x0CE1
        Data    0x0CCA
        Data    0x0CB3
        Data    0x0C9C
        Data    0x0C85
        Data    0x0C6E
        Data    0x0C57
        Data    0x0C40
        Data    0x0C2A
        Data    0x0C13
        Data    0x0BFC
        Data    0x0BE5
        Data    0x0BCE
        Data    0x0BB8
        Data    0x0BA1
        Data    0x0B8A
        Data    0x0B74
        Data    0x0B5D
        Data    0x0B46
        Data    0x0B2F
        Data    0x0B19
        Data    0x0B02
        Data    0x0AEB
        Data    0x0AD5
        Data    0x0ABE
        Data    0x0AA8
        Data    0x0A91
        Data    0x0A7A
        Data    0x0A64
        Data    0x0A4D
        Data    0x0A37
        Data    0x0A20
        Data    0x0A0A
        Data    0x09F3
        Data    0x09DD
        Data    0x09C6
        Data    0x09B0
        Data    0x0999
        Data    0x0983
        Data    0x096C
        Data    0x0956
        Data    0x0940
        Data    0x0929
        Data    0x0913
        Data    0x08FC
        Data    0x08E6
        Data    0x08D0
        Data    0x08B9
        Data    0x08A3
        Data    0x088D
        Data    0x0876
        Data    0x0860
        Data    0x084A
        Data    0x0834
        Data    0x081D
        Data    0x0807
        Data    0x07F1
        Data    0x07DB
        Data    0x07C5
        Data    0x07AE
        Data    0x0798
        Data    0x0782
        Data    0x076C
        Data    0x0756
        Data    0x0740
        Data    0x0729
        Data    0x0713
        Data    0x06FD
        Data    0x06E7
        Data    0x06D1
        Data    0x06BB
        Data    0x06A5
        Data    0x068F
        Data    0x0679
        Data    0x0663
        Data    0x064D
        Data    0x0637
        Data    0x0621
        Data    0x060B
        Data    0x05F5
        Data    0x05DF
        Data    0x05C9
        Data    0x05B3
        Data    0x059D
        Data    0x0587
        Data    0x0572
        Data    0x055C
        Data    0x0546
        Data    0x0530
        Data    0x051A
        Data    0x0504
        Data    0x04EE
        Data    0x04D9
        Data    0x04C3
        Data    0x04AD
        Data    0x0497
        Data    0x0482
        Data    0x046C
        Data    0x0456
        Data    0x0440
        Data    0x042B
        Data    0x0415
        Data    0x03FF
        Data    0x03EA
        Data    0x03D4
        Data    0x03BE
        Data    0x03A9
        Data    0x0393
        Data    0x037D
        Data    0x0368
        Data    0x0352
        Data    0x033D
        Data    0x0327
        Data    0x0311
        Data    0x02FC
        Data    0x02E6
        Data    0x02D1
        Data    0x02BB
        Data    0x02A6
        Data    0x0290
        Data    0x027B
        Data    0x0265
        Data    0x0250
        Data    0x023A
        Data    0x0225
        Data    0x0210
        Data    0x01FA
        Data    0x01E5
        Data    0x01CF
        Data    0x01BA
        Data    0x01A5
        Data    0x018F
        Data    0x017A
        Data    0x0164
        Data    0x014F
        Data    0x013A
        Data    0x0124
        Data    0x010F
        Data    0x00FA
        Data    0x00E5
        Data    0x00CF
        Data    0x00BA
        Data    0x00A5
        Data    0x0090
        Data    0x007A
        Data    0x0065
        Data    0x0050
        Data    0x003B
        Data    0x0026
        Data    0x0010
        Data    0xFFFB
        Data    0xFFE6
        Data    0xFFD1
        Data    0xFFBC
        Data    0xFFA7
        Data    0xFF92
        Data    0xFF7D
        Data    0xFF67
        Data    0xFF52
        Data    0xFF3D
        Data    0xFF28
        Data    0xFF13
        Data    0xFEFE
        Data    0xFEE9
        Data    0xFED4
        Data    0xFEBF
        Data    0xFEAA
        Data    0xFE95
        Data    0xFE80
        Data    0xFE6B
        Data    0xFE56
        Data    0xFE41
        Data    0xFE2C
        Data    0xFE18
        Data    0xFE03
        Data    0xFDEE
        Data    0xFDD9
        Data    0xFDC4
        Data    0xFDAF
        Data    0xFD9A
        Data    0xFD85
        Data    0xFD71
        Data    0xFD5C
        Data    0xFD47
        Data    0xFD32
        Data    0xFD1D
        Data    0xFD09
        Data    0xFCF4
        Data    0xFCDF
        Data    0xFCCA
        Data    0xFCB6
        Data    0xFCA1
        Data    0xFC8C
        Data    0xFC77
        Data    0xFC63
        Data    0xFC4E
        Data    0xFC39
        Data    0xFC25
        Data    0xFC10
        Data    0xFBFB
        Data    0xFBE7
        Data    0xFBD2
        Data    0xFBBE
        Data    0xFBA9
        Data    0xFB94
        Data    0xFB80
        Data    0xFB6B
        Data    0xFB57
        Data    0xFB42
        Data    0xFB2D
        Data    0xFB19
        Data    0xFB04
        Data    0xFAF0
        Data    0xFADB
        Data    0xFAC7
        Data    0xFAB2
        Data    0xFA9E
        Data    0xFA89
        Data    0xFA75
        Data    0xFA61
        Data    0xFA4C
        Data    0xFA38
        Data    0xFA23
        Data    0xFA0F
        Data    0xF9FA
        Data    0xF9E6
        Data    0xF9D2
        Data    0xF9BD
        Data    0xF9A9
        Data    0xF995
        Data    0xF980
        Data    0xF96C
        Data    0xF958
        Data    0xF943
        Data    0xF92F
        Data    0xF91B
        Data    0xF907
        Data    0xF8F2
        Data    0xF8DE
        Data    0xF8CA
        Data    0xF8B5
        Data    0xF8A1
        Data    0xF88D
        Data    0xF879
        Data    0xF865
        Data    0xF850
        Data    0xF83C
        Data    0xF828
        Data    0xF814
        Data    0xF800
        Data    0xF7EC
        Data    0xF7D7
        Data    0xF7C3
        Data    0xF7AF
        Data    0xF79B
        Data    0xF787
        Data    0xF773
        Data    0xF75F
        Data    0xF74B
        Data    0xF737
        Data    0xF723
        Data    0xF70F
        Data    0xF6FB
        Data    0xF6E7
        Data    0xF6D3
        Data    0xF6BF
        Data    0xF6AB
        Data    0xF697
        Data    0xF683
        Data    0xF66F
        Data    0xF65B
        Data    0xF647
        Data    0xF633
        Data    0xF61F
        Data    0xF60B
        Data    0xF5F7
        Data    0xF5E3
        Data    0xF5CF
        Data    0xF5BC
        Data    0xF5A8
        Data    0xF594
        Data    0xF580
        Data    0xF56C
        Data    0xF558
        Data    0xF544
        Data    0xF531
        Data    0xF51D
        Data    0xF509
        Data    0xF4F5
        Data    0xF4E1
        Data    0xF4CE
        Data    0xF4BA
        Data    0xF4A6
        Data    0xF492
        Data    0xF47F
        Data    0xF46B
        Data    0xF457
        Data    0xF444
        Data    0xF430
        Data    0xF41C
        Data    0xF409
        Data    0xF3F5
        Data    0xF3E1
        Data    0xF3CE
        Data    0xF3BA
        Data    0xF3A6
        Data    0xF393
        Data    0xF37F
        Data    0xF36C
        Data    0xF358
        Data    0xF344
        Data    0xF331
        Data    0xF31D
        Data    0xF30A
        Data    0xF2F6
        Data    0xF2E3
        Data    0xF2CF
        Data    0xF2BC
        Data    0xF2A8
        Data    0xF294
        Data    0xF281
        Data    0xF26E
        Data    0xF25A
        Data    0xF247
        Data    0xF233
        Data    0xF220
        Data    0xF20C
        Data    0xF1F9
        Data    0xF1E5
        Data    0xF1D2
        Data    0xF1BF
        Data    0xF1AB
        Data    0xF198
        Data    0xF184
        Data    0xF171
        Data    0xF15E
        Data    0xF14A
        Data    0xF137
        Data    0xF124
        Data    0xF110
        Data    0xF0FD
        Data    0xF0EA
        Data    0xF0D6
        Data    0xF0C3
        Data    0xF0B0
        Data    0xF09D
        Data    0xF089
        Data    0xF076
        Data    0xF063
        Data    0xF050
        Data    0xF03C
        Data    0xF029
        Data    0xF016
        Data    0xF003
        Data    0xEFF0
        Data    0xEFDC
        Data    0xEFC9
        Data    0xEFB6
        Data    0xEFA3
        Data    0xEF90
        Data    0xEF7D
        Data    0xEF69
        Data    0xEF56
        Data    0xEF43
        Data    0xEF30
        Data    0xEF1D
    endif

